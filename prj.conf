## CMakeLists.txt
```
cmake_minimum_required(VERSION 3.20.0)
find_package(Zephyr REQUIRED HINTS $ENV{ZEPHYR_BASE})

project(nrfbuttonclassification)

target_sources(app PRIVATE src/main.c)

# ============================================================================
# Edge Impulse Model Selection
# For testing ei-v2, comment out 'ei' and use 'ei-v2' instead
# Only ONE model can be active at a time due to symbol conflicts
# ============================================================================

# Original model (ei) - COMMENTED OUT FOR TESTING ei-v2
# add_subdirectory(ei)
# target_sources(app PRIVATE src/ei_glue.cpp)

# New model (ei-v2) - ACTIVE FOR TESTING
add_subdirectory(ei-v2)
target_sources(app PRIVATE src/ei_glue_v2.cpp)

# *** link minimal C++ runtime libs ***
# stdc++ provides new/delete, std::function, etc.
# supc++ provides low-level support (pure virtuals, atexit helpers on ARM, etc.)
zephyr_link_libraries(stdc++)
zephyr_link_libraries(supc++)
```

## prj.conf
```kconfig
CONFIG_STATIC_INIT_GNU=y
```

## src/main.c
```c
/*
 * Copyright (c) 2016 Open-RnD Sp. z o.o.
 * Copyright (c) 2020 Nordic Semiconductor ASA
 *
 * SPDX-License-Identifier: Apache-2.0
 *
 * NOTE: If you are looking into an implementation of button events with
 * debouncing, check out `input` subsystem and `samples/subsys/input/input_dump`
 * example instead.
 */

#include <zephyr/kernel.h>
#include <zephyr/device.h>
#include <zephyr/drivers/gpio.h>
#include <zephyr/sys/util.h>
#include <zephyr/sys/printk.h>
#include <inttypes.h>

#define SLEEP_TIME_MS	1
#define WINDOW 10
#define WINDOW_MS 2000  /* your 2-second window in milliseconds */


/*
 * Get button configuration from the devicetree sw0 alias. This is mandatory.
 */
#define SW0_NODE	DT_ALIAS(sw0)
#define TIMER_INSTANCE 0
#if !DT_NODE_HAS_STATUS_OKAY(SW0_NODE)
#error "Unsupported board: sw0 devicetree alias is not defined"
#endif
static const struct gpio_dt_spec button = GPIO_DT_SPEC_GET_OR(SW0_NODE, gpios,
							      {0});
static struct gpio_callback button_cb_data;
static uint32_t counter = 0;	// counter per button presses
uint32_t lastPressTime = 0;
uint32_t deltaSum = 0;
uint32_t deltaCount = 0;
bool filled = false;

/* C-callable shim implemented in src/ei_glue_v2.cpp for testing ei-v2 model */
int ei_v2_classify_test(const char **out_label, float *out_score);

void timer_expiry(struct k_timer *timer_id){
	/* Take a snapshot of current stats while interrupts are off */
	__disable_irq();

	/* Compute average only if we have at least one interval */
	uint32_t avgMS = 0;
	if (deltaCount > 0) {
		uint32_t avgCycle = deltaSum / deltaCount;          /* average cycles */
		avgMS = k_cyc_to_ms_floor32(avgCycle);              /* cycles -> ms */
	}

	/* Print stats for this 2-second window */
	printk("--- Window stats: %u presses, avg interval %u ms ---\n", counter, avgMS);

	/* Reset state for next window */
	deltaSum = 0;
	deltaCount = 0;
	lastPressTime = 0;
	counter = 0;

	__enable_irq();
}


K_TIMER_DEFINE(my_timer,timer_expiry,NULL);


/*
 * The led0 devicetree alias is optional. If present, we'll use it
 * to turn on the LED whenever the button is pressed.
 */
static struct gpio_dt_spec led = GPIO_DT_SPEC_GET_OR(DT_ALIAS(led0), gpios,
						     {0});

void button_pressed(const struct device *dev, struct gpio_callback *cb,
		    uint32_t pins)
{
	uint32_t now = k_cycle_get_32();
	if(lastPressTime != 0){
		uint32_t delta = now - lastPressTime;
		deltaSum += delta;
		deltaCount++;
	}
	lastPressTime = now;
	counter++;
	printk("Button press #%u - Running EI-v2 classification...\n", counter);
	
	/* Run classification with demo data on button press */
	uint32_t t0 = k_cycle_get_32();
	const char *label = NULL;
	float score = 0.0f;
	int e = ei_v2_classify_test(&label, &score);
	uint32_t t1 = k_cycle_get_32();
	
	uint32_t dt_us = k_cyc_to_us_floor32(t1 - t0);
	
	if (e == 0 && label) {
		printk(">>> EI-v2 Result: %s (%.2f), latency: %u us\n",
			label, (double)score, dt_us);
	} else {
		printk(">>> EI-v2 classify error: %d\n", e);
	}
}

int main(void)
{
	
	k_timer_start(&my_timer,K_SECONDS(2),K_SECONDS(2));	// Total time per window
	int ret;

	if (!gpio_is_ready_dt(&button)) {
		printk("Error: button device %s is not ready\n",
		       button.port->name);
		return 0;
	}

	ret = gpio_pin_configure_dt(&button, GPIO_INPUT);
	if (ret != 0) {
		printk("Error %d: failed to configure %s pin %d\n",
		       ret, button.port->name, button.pin);
		return 0;
	}

	ret = gpio_pin_interrupt_configure_dt(&button,
					      GPIO_INT_EDGE_TO_ACTIVE);
	if (ret != 0) {
		printk("Error %d: failed to configure interrupt on %s pin %d\n",
			ret, button.port->name, button.pin);
		return 0;
	}

	gpio_init_callback(&button_cb_data, button_pressed, BIT(button.pin));
	gpio_add_callback(button.port, &button_cb_data);
	printk("Set up button at %s pin %d\n", button.port->name, button.pin);

	if (led.port && !gpio_is_ready_dt(&led)) {
		printk("Error %d: LED device %s is not ready; ignoring it\n",
		       ret, led.port->name);
		led.port = NULL;
	}
	if (led.port) {
		ret = gpio_pin_configure_dt(&led, GPIO_OUTPUT);
		if (ret != 0) {
			printk("Error %d: failed to configure LED device %s pin %d\n",
			       ret, led.port->name, led.pin);
			led.port = NULL;
		} else {
			printk("Set up LED at %s pin %d\n", led.port->name, led.pin);
		}
	}

	printk("Press the button\n");
	if (led.port) {
		while (1) {
			/* If we have an LED, match its state to the button's. */
			int val = gpio_pin_get_dt(&button);

			if (val >= 0) {
				gpio_pin_set_dt(&led, val);
			}
			k_msleep(SLEEP_TIME_MS);
		}
	}
	return 0;
}
```

## src/ei2_glue.cpp
```c
#include "edge-impulse-sdk/classifier/ei_run_classifier.h"
#include "edge-impulse-sdk/dsp/numpy.hpp"
#include "model-parameters/model_metadata.h"

extern "C" int ei2_classify_array(const float *input_array, size_t array_size,
                                   const char **out_label, float *out_score)
{
    // Check that the input array size matches the model's expected input size
    if (array_size != EI_CLASSIFIER_DSP_INPUT_FRAME_SIZE) {
        return -99; // model mismatch - wrong input size
    }

    // Wrap input array in a signal
    signal_t signal;
    if (numpy::signal_from_buffer(input_array,
                                  EI_CLASSIFIER_DSP_INPUT_FRAME_SIZE,
                                  &signal) != 0) {
        return -98;
    }

    ei_impulse_result_t result = {};
    // Run the classifier
    EI_IMPULSE_ERROR err = run_classifier(&signal, &result, /*debug*/ false);
    if (err != EI_IMPULSE_OK) {
        return static_cast<int>(err);
    }

    // Find the top class
    size_t best_i = 0;
    float  best_v = result.classification[0].value;
    for (size_t i = 1; i < EI_CLASSIFIER_LABEL_COUNT; i++) {
        if (result.classification[i].value > best_v) {
            best_v = result.classification[i].value;
            best_i = i;
        }
    }

    if (out_label) *out_label = result.classification[best_i].label;
    if (out_score) *out_score = best_v;
    return 0;
}
```

## src/ei_glue.cpp
```c
#include "edge-impulse-sdk/classifier/ei_run_classifier.h"
#include "edge-impulse-sdk/dsp/numpy.hpp"
#include "model-parameters/model_metadata.h"
#include <fstream>
#include <iostream>
#include <sstream>
#include <string>
#include <vector>

extern "C" int ei_classify_csv(const char *csv_file_path);

extern "C" int ei_classify_three(float presses, float avg_ms, float window_ms,
                                 const char **out_label, float *out_score)
{
    // Build feature vector in the SAME order you trained on
    // (button_presses, avg_response_ms, window_ms)
    static float features[EI_CLASSIFIER_DSP_INPUT_FRAME_SIZE];

    if (EI_CLASSIFIER_DSP_INPUT_FRAME_SIZE < 3) {
        return -99; // model mismatch
    }
    features[0] = presses;
    features[1] = avg_ms;
    features[2] = window_ms;

    // Wrap features in a signal
    signal_t signal;
    if (numpy::signal_from_buffer(features,
                                  EI_CLASSIFIER_DSP_INPUT_FRAME_SIZE,
                                  &signal) != 0) {
        return -98;
    }

    ei_impulse_result_t result = {};
    // NOTE: the correct API name is run_classifier(...)
    EI_IMPULSE_ERROR err = run_classifier(&signal, &result, /*debug*/ false);
    if (err != EI_IMPULSE_OK) {
        return static_cast<int>(err);
    }

    // Find the top class
    size_t best_i = 0;
    float  best_v = result.classification[0].value;
    for (size_t i = 1; i < EI_CLASSIFIER_LABEL_COUNT; i++) {
        if (result.classification[i].value > best_v) {
            best_v = result.classification[i].value;
            best_i = i;
        }
    }

    if (out_label) *out_label = result.classification[best_i].label;
    if (out_score) *out_score = best_v;
    return 0;
}

extern "C" int ei_classify_csv(const char *csv_file_path) {
    std::ifstream file(csv_file_path);
    if (!file.is_open()) {
        std::cerr << "Error: Could not open file " << csv_file_path << std::endl;
        return -1; // Cannot open file
    }

    std::string line;
    // Skip header
    if (!std::getline(file, line)) {
        return -2; // File is empty or unreadable
    }

    std::vector<float> x_vals, y_vals, z_vals;
    while (std::getline(file, line)) {
        std::stringstream ss(line);
        std::string value;
        // timestamp,x,y,z,label
        std::getline(ss, value, ','); // timestamp
        std::getline(ss, value, ','); // x
        x_vals.push_back(std::stof(value));
        std::getline(ss, value, ','); // y
        y_vals.push_back(std::stof(value));
        std::getline(ss, value, ','); // z
        z_vals.push_back(std::stof(value));
    }

    const int window_size = 25;
    const int num_axes = 3;
    if (EI_CLASSIFIER_DSP_INPUT_FRAME_SIZE != window_size * num_axes) {
        std::cerr << "Error: Mismatch between CSV data shape and model input size." << std::endl;
        return -3; // Model input size mismatch
    }

    size_t num_samples = x_vals.size();
    size_t num_windows = num_samples / window_size;

    for (size_t i = 0; i < num_windows; ++i) {
        static float features[EI_CLASSIFIER_DSP_INPUT_FRAME_SIZE];
        size_t feature_ix = 0;

        // The model expects a flat array of accelerometer data, window by window.
        // The input shape is (3, 25, 1), so we flatten it as [x1..x25, y1..y25, z1..z25]
        size_t start_index = i * window_size;
        for(int j = 0; j < window_size; ++j) features[feature_ix++] = x_vals[start_index + j];
        for(int j = 0; j < window_size; ++j) features[feature_ix++] = y_vals[start_index + j];
        for(int j = 0; j < window_size; ++j) features[feature_ix++] = z_vals[start_index + j];

        signal_t signal;
        if (numpy::signal_from_buffer(features, EI_CLASSIFIER_DSP_INPUT_FRAME_SIZE, &signal) != 0) {
            std::cerr << "Window " << i << ": Failed to create signal from buffer." << std::endl;
            continue;
        }

        ei_impulse_result_t result = {};
        EI_IMPULSE_ERROR err = run_classifier(&signal, &result, /*debug*/ false);
        if (err != EI_IMPULSE_OK) {
            std::cerr << "Window " << i << ": Classifier failed with error " << err << std::endl;
            continue;
        }

        // Find and print the top class
        size_t best_i = 0;
        float best_v = 0;
        for (size_t k = 0; k < EI_CLASSIFIER_LABEL_COUNT; k++) {
            if (result.classification[k].value > best_v) {
                best_v = result.classification[k].value;
                best_i = k;
            }
        }
        std::cout << "Window " << i << ": Predicted: " << result.classification[best_i].label
                  << " (" << best_v << ")" << std::endl;
    }

    return 0;
}
```

## src/ei_glue_v2.cpp
```c
/**
 * ei_glue_v2.cpp - C-callable wrapper for the ei-v2 Edge Impulse model
 * 
 * This file uses the ei-v2 model which expects 75 input features.
 * Input shape: (3, 25, 1) - 3 features, 25 time steps, 1 channel.
 * TensorFlow flattens this column-by-column (all of feature 0, then feature 1, then feature 2).
 * For testing, we use real demo data from the training set.
 */

#include "edge-impulse-sdk/classifier/ei_run_classifier.h"
#include "edge-impulse-sdk/dsp/numpy.hpp"
#include "model-parameters/model_metadata.h"

// Demo data: shape (3, 25, 1) flattened in C order (column-major from original table)
// Order: Column 1 (all 25 rows), Column 2 (all 25 rows), Column 3 (all 25 rows)
static const float demo_data[75] = {
    // Column 1 (X) - 25 samples
    -21.0f, -31.0f, -21.0f, -18.0f, -27.0f, -30.0f, -22.0f, -23.0f, -30.0f, -20.0f, 
    -38.0f, -44.0f, -33.0f, -31.0f, -24.0f, -43.0f, -53.0f, -33.0f, -31.0f, -23.0f, 
    -34.0f, -36.0f, -43.0f, -38.0f, -38.0f, 
    // Column 2 (Y) - 25 samples
    -487.0f, -491.0f, -486.0f, -485.0f, -487.0f, -485.0f, -485.0f, -478.0f, -487.0f, -493.0f, 
    -486.0f, -491.0f, -486.0f, -478.0f, -483.0f, -477.0f, -481.0f, -483.0f, -484.0f, -479.0f, 
    -491.0f, -493.0f, -482.0f, -490.0f, -479.0f, 
    // Column 3 (Z) - 25 samples
    -193.0f, -169.0f, -194.0f, -175.0f, -201.0f, -181.0f, -187.0f, -188.0f, -188.0f, -188.0f, 
    -182.0f, -181.0f, -179.0f, -169.0f, -184.0f, -184.0f, -197.0f, -184.0f, -188.0f, -184.0f, 
    -181.0f, -160.0f, -179.0f, -201.0f, -184.0f
};

extern "C" int ei_v2_classify_test(const char **out_label, float *out_score)
{
    // Copy demo data to mutable buffer (required by signal_from_buffer)
    static float features[75];
    for (int i = 0; i < 75; i++) {
        features[i] = demo_data[i];
    }

    // Wrap features in a signal
    signal_t signal;
    if (numpy::signal_from_buffer(features, 75, &signal) != 0) {
        return -98;
    }

    ei_impulse_result_t result = {};
    EI_IMPULSE_ERROR err = run_classifier(&signal, &result, /*debug*/ false);
    if (err != EI_IMPULSE_OK) {
        return static_cast<int>(err);
    }

    // Find the top class
    size_t best_i = 0;
    float  best_v = result.classification[0].value;
    for (size_t i = 1; i < EI_CLASSIFIER_LABEL_COUNT; i++) {
        if (result.classification[i].value > best_v) {
            best_v = result.classification[i].value;
            best_i = i;
        }
    }

    if (out_label) *out_label = result.classification[best_i].label;
    if (out_score) *out_score = best_v;
    return 0;
}
```

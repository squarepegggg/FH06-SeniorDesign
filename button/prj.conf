## CMakeLists.txt
```
# SPDX-License-Identifier: Apache-2.0

cmake_minimum_required(VERSION 3.20.0)
find_package(Zephyr REQUIRED HINTS $ENV{ZEPHYR_BASE})
project(button LANGUAGES C CXX)

# Set C++ standard (required by Edge Impulse library)
set(CMAKE_CXX_STANDARD 11)
set(CMAKE_CXX_STANDARD_REQUIRED ON)

# Add C and C++ source files
target_sources(app PRIVATE src/main.c)
target_sources(app PRIVATE src/ei_classifier_wrapper.cpp)

# Add include directory for wrapper header
target_include_directories(app PRIVATE src)

# Add classification-task-demo library
add_subdirectory(${CMAKE_CURRENT_SOURCE_DIR}/../classification-task-demo-cpp-mcu-v1 ${CMAKE_CURRENT_BINARY_DIR}/classification-task-demo)
```

## prj.conf
```kconfig
CONFIG_GPIO=y

# Enable C++ support for Edge Impulse library
CONFIG_CPP=y
CONFIG_LIB_CPLUSPLUS=y

# Memory configuration - ensure sufficient heap for Edge Impulse
# The model requires ~3KB arena (EI_CLASSIFIER_TFLITE_LARGEST_ARENA_SIZE = 2944)
# Add extra heap for signal processing and other operations
CONFIG_HEAP_MEM_POOL_SIZE=8192

# Enable floating point support (required for Edge Impulse)
# Note: nRF52840 has hardware FPU, nRF52832 uses software FPU
# If using nRF52832, remove CONFIG_FPU=y and use software FPU
CONFIG_FPU=y

# Enable printf for debug output
CONFIG_PRINTK=y
CONFIG_STDOUT_CONSOLE=y

# C++ standard library support (minimal for embedded)
CONFIG_NEWLIB_LIBC=y
```

## src/main.c
```c
/*
 * Copyright (c) 2016 Open-RnD Sp. z o.o.
 * Copyright (c) 2020 Nordic Semiconductor ASA
 *
 * SPDX-License-Identifier: Apache-2.0
 *
 * NOTE: If you are looking into an implementation of button events with
 * debouncing, check out `input` subsystem and `samples/subsys/input/input_dump`
 * example instead.
 */

#include <zephyr/kernel.h>
#include <zephyr/device.h>
#include <zephyr/drivers/gpio.h>
#include <zephyr/sys/util.h>
#include <zephyr/sys/printk.h>
#include <inttypes.h>
#include "ei_classifier_wrapper.h"

#define SLEEP_TIME_MS	1
#define WINDOW 10

/*
 * Get button configuration from the devicetree sw0 alias. This is mandatory.
 */
#define SW0_NODE	DT_ALIAS(sw0)
#define TIMER_INSTANCE 0
#if !DT_NODE_HAS_STATUS_OKAY(SW0_NODE)
#error "Unsupported board: sw0 devicetree alias is not defined"
#endif
static const struct gpio_dt_spec button = GPIO_DT_SPEC_GET_OR(SW0_NODE, gpios,
							      {0});
static struct gpio_callback button_cb_data;
static uint32_t counter = 0;	// counter per button presses
uint32_t lastPressTime = 0;
uint32_t deltaSum = 0;
uint32_t deltaCount = 0;
bool filled = false;
uint32_t windowStartTime = 0;  // Track window start time for total_duration_ms

/**
 * Run classification on button press features
 */
void run_classification(void)
{
	// Calculate features for the model
	// Model expects: press_count, avg_interval_ms, total_duration_ms
	float press_count = (float)counter;
	
	float avg_interval_ms = 0.0f;
	if (deltaCount > 0) {
		uint32_t avgCycle = deltaSum / deltaCount;
		avg_interval_ms = (float)k_cyc_to_ms_floor32(avgCycle);
	}
	
	float total_duration_ms = 0.0f;
	if (windowStartTime > 0) {
		uint32_t now = k_cycle_get_32();
		uint32_t elapsedCycles = now - windowStartTime;
		total_duration_ms = (float)k_cyc_to_ms_floor32(elapsedCycles);
	}
	
	// Prepare feature array as expected by the model
	float features[3] = {press_count, avg_interval_ms, total_duration_ms};
	
	// Run classification through C wrapper
	ei_classification_result_t result;
	int err = ei_run_classification(features, &result);
	
	if (err != 0) {
		printk("ERR: Failed to run classification\n");
		return;
	}
	
	// Print classification results
	printk("Classification results:\n");
	printk("    single: %.3f\n", result.single_value);
	printk("    double: %.3f\n", result.double_value);
	printk("    long: %.3f\n", result.long_value);
	printk("Predicted: %s (confidence: %.3f)\n", result.predicted_label, result.confidence);
}

void timer_expiry(struct k_timer *timer_id){
	__disable_irq();
	if(deltaCount > 0){
		uint32_t avgCycle = deltaSum / deltaCount;	// calculates avg cycles 
		uint32_t avgMS = k_cyc_to_ms_floor32(avgCycle);
		printk("Avg Response Time: %u ms over %u presses\n",avgMS,deltaCount);

	} else {
		printk("Avg Response Time: 0\n");	
	}
	deltaSum = 0;	// sum of respones times
	deltaCount = 0;	// total count
	lastPressTime = 0;	// reference to last button press time
	printk("Number of Button Presses: %d\n",counter);
	
	// Run classification before resetting
	if (counter > 0) {
		run_classification();
	}
	
	counter = 0;	// resets button presses
	windowStartTime = k_cycle_get_32();  // Reset window start time
	__enable_irq();
}

K_TIMER_DEFINE(my_timer,timer_expiry,NULL);


/*
 * The led0 devicetree alias is optional. If present, we'll use it
 * to turn on the LED whenever the button is pressed.
 */
static struct gpio_dt_spec led = GPIO_DT_SPEC_GET_OR(DT_ALIAS(led0), gpios,
						     {0});

void button_pressed(const struct device *dev, struct gpio_callback *cb,
		    uint32_t pins)
{
	uint32_t now = k_cycle_get_32();
	if(lastPressTime != 0){
		uint32_t delta = now - lastPressTime;
		deltaSum += delta;
		deltaCount++;
	} else {
		// First press in this window, set window start time
		windowStartTime = now;
	}
	lastPressTime = now;
	counter++;
	printk("%d\n",counter);	// prints # of button presses
	
	// Run classification on button press
	run_classification();
	//printk("Button pressed at %" PRIu32 "\n", k_cycle_get_32());
}

int main(void)
{
	
	k_timer_start(&my_timer,K_SECONDS(2),K_SECONDS(2));	// Total time per window
	windowStartTime = k_cycle_get_32();  // Initialize window start time
	int ret;

	if (!gpio_is_ready_dt(&button)) {
		printk("Error: button device %s is not ready\n",
		       button.port->name);
		return 0;
	}

	ret = gpio_pin_configure_dt(&button, GPIO_INPUT);
	if (ret != 0) {
		printk("Error %d: failed to configure %s pin %d\n",
		       ret, button.port->name, button.pin);
		return 0;
	}

	ret = gpio_pin_interrupt_configure_dt(&button,
					      GPIO_INT_EDGE_TO_ACTIVE);
	if (ret != 0) {
		printk("Error %d: failed to configure interrupt on %s pin %d\n",
			ret, button.port->name, button.pin);
		return 0;
	}

	gpio_init_callback(&button_cb_data, button_pressed, BIT(button.pin));
	gpio_add_callback(button.port, &button_cb_data);
	printk("Set up button at %s pin %d\n", button.port->name, button.pin);

	if (led.port && !gpio_is_ready_dt(&led)) {
		printk("Error %d: LED device %s is not ready; ignoring it\n",
		       ret, led.port->name);
		led.port = NULL;
	}
	if (led.port) {
		ret = gpio_pin_configure_dt(&led, GPIO_OUTPUT);
		if (ret != 0) {
			printk("Error %d: failed to configure LED device %s pin %d\n",
			       ret, led.port->name, led.pin);
			led.port = NULL;
		} else {
			printk("Set up LED at %s pin %d\n", led.port->name, led.pin);
		}
	}

	printk("Press the button\n");
	if (led.port) {
		while (1) {
			/* If we have an LED, match its state to the button's. */
			int val = gpio_pin_get_dt(&button);

			if (val >= 0) {
				gpio_pin_set_dt(&led, val);
			}
			k_msleep(SLEEP_TIME_MS);
		}
	}
	return 0;
}
```

## src/ei_classifier_wrapper.cpp
```c
#include "ei_classifier_wrapper.h"
#include <string.h>

// C++ includes for Edge Impulse
#include "edge-impulse-sdk/classifier/ei_run_classifier.h"
#include "edge-impulse-sdk/dsp/numpy.hpp"

extern "C" {

int ei_run_classification(float features[3], ei_classification_result_t *result)
{
    if (result == NULL) {
        return EI_WRAPPER_ERROR;
    }

    // Initialize result structure
    result->single_value = 0.0f;
    result->double_value = 0.0f;
    result->long_value = 0.0f;
    result->predicted_label = "unknown";
    result->confidence = 0.0f;

    // Create signal from buffer
    signal_t signal;
    int err = numpy::signal_from_buffer(features, 3, &signal);
    if (err != 0) {
        return EI_WRAPPER_ERROR;
    }

    // Run classification
    ei_impulse_result_t ei_result = { 0 };
    EI_IMPULSE_ERROR res = run_classifier(&signal, &ei_result, false);

    if (res != EI_IMPULSE_OK) {
        return EI_WRAPPER_ERROR;
    }

    // Extract results - assuming the labels are in order: single, double, long
    // We need to match by label name since order might vary
    for (size_t ix = 0; ix < EI_CLASSIFIER_LABEL_COUNT; ix++) {
        const char* label = ei_result.classification[ix].label;
        float value = ei_result.classification[ix].value;

        if (strcmp(label, "single") == 0) {
            result->single_value = value;
        } else if (strcmp(label, "double") == 0) {
            result->double_value = value;
        } else if (strcmp(label, "long") == 0) {
            result->long_value = value;
        }

        // Track highest confidence
        if (value > result->confidence) {
            result->confidence = value;
            result->predicted_label = label;
        }
    }

    return EI_WRAPPER_OK;
}

} // extern "C"
```

## src/ei_classifier_wrapper.h
```c
#ifndef EI_CLASSIFIER_WRAPPER_H
#define EI_CLASSIFIER_WRAPPER_H

#ifdef __cplusplus
extern "C" {
#endif

// Error codes
typedef enum {
    EI_WRAPPER_OK = 0,
    EI_WRAPPER_ERROR = -1
} ei_wrapper_error_t;

// Classification result structure for C
typedef struct {
    float single_value;
    float double_value;
    float long_value;
    const char* predicted_label;
    float confidence;
} ei_classification_result_t;

/**
 * Run classification on feature array
 * @param features Array of 3 floats: [press_count, avg_interval_ms, total_duration_ms]
 * @param result Output classification result
 * @return 0 on success, negative on error
 */
int ei_run_classification(float features[3], ei_classification_result_t *result);

#ifdef __cplusplus
}
#endif

#endif // EI_CLASSIFIER_WRAPPER_H
```
